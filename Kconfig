## Kconfig
```kconfig
# SPDX-License-Identifier: ISC

menuconfig TINYPSA
	bool "tinypsa PSA Crypto API provider"
	default y
	depends on PSA_CRYPTO_PROVIDER_CUSTOM
	select PSA_CRYPTO_CLIENT
	select ENTROPY_GENERATOR
	help
	  Minimal PSA Crypto API provider: only the calls OpenThread, the
	  Zephyr Bluetooth host and UltraWideLock make, over a vetted
	  primitive backend.

if TINYPSA

choice TINYPSA_BACKEND
	prompt "Primitive backend"
	default TINYPSA_BACKEND_PORTABLE if CPU_CORTEX_M4 || CPU_CORTEX_M33
	default TINYPSA_BACKEND_OCRYPTO

config TINYPSA_BACKEND_OCRYPTO
	bool "Nordic Oberon (ocrypto)"
	depends on SOC_FAMILY_NORDIC_NRF
	select NRF_OBERON
	help
	  Links nrf_oberon from the NCS install. Its license limits use to
	  Nordic chips.

config TINYPSA_BACKEND_PORTABLE
	bool "Portable (vendored BearSSL and P256-Cortex-M4)"
	depends on CPU_CORTEX_M4 || CPU_CORTEX_M33
	help
	  SHA-256, HMAC, AES, CCM and GCM from a vendored BearSSL subset, and
	  P-256 from vendored P256-Cortex-M4, whose assembly needs a
	  Cortex-M4 or M33. Nothing comes from the SDK.

endchoice

config TINYPSA_P256_FAST_BASEMULT
	bool "Fast fixed-base P-256 multiply (portable backend)"
	default y
	depends on TINYPSA_BACKEND_PORTABLE
	help
	  Key generation and signing multiply by the base point through
	  P256-Cortex-M4's precomputed-table routine instead of its generic
	  one, which upstream says "dramatically improves performance" of
	  both. On the door-lock image (decawave_dwm3001cdk, LTO on, measured
	  2026-10-16) it costs 1,392 B of flash, makes Matter CASE 17%
	  faster and takes 856 B off the signing stack. Off, OpenThread's SRP
	  client overflows the OpenThread thread's 4 KB stack when it signs.

config TINYPSA_AES_MPSL
	bool "AES-128 on the nRF ECB peripheral (portable backend)"
	depends on TINYPSA_BACKEND_PORTABLE && MPSL_BUILD_TYPE_LIB
	help
	  Single-block AES-128 (ECB, CMAC, OpenThread's AES) runs on the ECB
	  peripheral through MPSL, which shares it with the Bluetooth
	  controller and the 802.15.4 driver, instead of BearSSL's
	  constant-time software AES. CCM, GCM and 256-bit keys stay in
	  software. Off by default: see PLAN.md for what is still unverified.

config TINYPSA_KEY_SLOTS
	int "Key slots"
	default 16
	help
	  Keys held in RAM at once, volatile and cached persistent together.
	  Each slot costs about 24 B plus TINYPSA_KEY_MAX_SIZE.

config TINYPSA_KEY_MAX_SIZE
	int "Largest key, in bytes"
	default 65
	range 32 255
	help
	  65 holds an uncompressed P-256 public key. Raise it only for longer
	  HMAC keys or passwords, such as a Thread passphrase over 65 bytes.

config TINYPSA_KDF_INPUT_MAX
	int "Largest buffered KDF input, in bytes"
	default 64
	range 16 255
	help
	  Salt and info are held in the operation until output is drawn.
	  The buffer lives on the caller's stack.

config TINYPSA_DRBG_RESEED_INTERVAL
	int "HMAC_DRBG requests between reseeds"
	default 4096

config TINYPSA_PERSISTENT_KEYS
	bool "Persistent keys in Zephyr settings"
	default y
	depends on SETTINGS
	help
	  Keys with a persistent lifetime are stored as settings entries
	  named tinypsa/<id>, in the clear.

config TINYPSA_OPENTHREAD
	bool "OpenThread's crypto platform over tinypsa's primitives"
	default y
	depends on OPENTHREAD && !OPENTHREAD_CRYPTO_PSA && !OPENTHREAD_PLATFORM_KEY_REF
	help
	  Implements OpenThread's otPlatCrypto hooks directly, with
	  OPENTHREAD_CONFIG_CRYPTO_LIB_PLATFORM, so OpenThread makes no PSA
	  calls. OpenThread then keeps literal keys in its own settings.

endif # TINYPSA
```
