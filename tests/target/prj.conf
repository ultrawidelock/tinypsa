## CMakeLists.txt
```
# SPDX-FileCopyrightText: 2026 Aseem Chopra
# SPDX-License-Identifier: Apache-2.0
#
# The host tests on a Nordic board, over the ocrypto backend:
#
#   west build -b <board> -d build/target tests/target
#
# With tests/vectors/fetch.sh run, a sample of the vector tables is included,
# sized by TINYPSA_VECTOR_BUDGET (bytes of hex).
cmake_minimum_required(VERSION 3.20)
list(APPEND ZEPHYR_EXTRA_MODULES ${CMAKE_CURRENT_SOURCE_DIR}/../..)
find_package(Zephyr REQUIRED HINTS $ENV{ZEPHYR_BASE})
project(tinypsa_target_test)

set(ROOT ${CMAKE_CURRENT_SOURCE_DIR}/../..)
set(HOST ${ROOT}/tests/host)
target_sources(app PRIVATE src/main.c ${HOST}/test_main.c ${HOST}/test_smoke.c)
# The host suite's main runs first from src/main.c.
set_source_files_properties(${HOST}/test_main.c PROPERTIES COMPILE_DEFINITIONS main=test_host_main)
target_include_directories(app PRIVATE
  ${HOST} ${ROOT}/src/core ${ROOT}/src/backend ${ROOT}/src/port)

set(TINYPSA_VECTORS_DIR "${ROOT}/build/vectors" CACHE PATH "Fetched test vectors")
set(TINYPSA_VECTOR_BUDGET 300000 CACHE STRING "Bytes of vector hex to include")
if(EXISTS "${TINYPSA_VECTORS_DIR}/wycheproof")
  add_custom_command(OUTPUT ${CMAKE_CURRENT_BINARY_DIR}/vectors.c
    COMMAND ${PYTHON_EXECUTABLE} -I ${HOST}/gen_vectors.py
            ${TINYPSA_VECTORS_DIR} ${CMAKE_CURRENT_BINARY_DIR}/vectors.c ${TINYPSA_VECTOR_BUDGET}
    DEPENDS ${HOST}/gen_vectors.py ${ROOT}/tests/vectors/sources.sha256)
  target_sources(app PRIVATE ${HOST}/test_vectors.c ${CMAKE_CURRENT_BINARY_DIR}/vectors.c)
  target_compile_definitions(app PRIVATE TINYPSA_HAVE_VECTORS)
else()
  message(WARNING "no vectors in ${TINYPSA_VECTORS_DIR}: run tests/vectors/fetch.sh")
endif()
```

## prj.conf
```kconfig
# tinypsa as the PSA provider; on NCS, nrf_security off.
CONFIG_PSA_CRYPTO=y
CONFIG_PSA_CRYPTO_PROVIDER_CUSTOM=y
CONFIG_NRF_SECURITY=n
# The suite runs over ocrypto, which has no host build.
CONFIG_TINYPSA_BACKEND_OCRYPTO=y

# Everything tinypsa implements (tests/host/host_psa_want.h).
CONFIG_PSA_WANT_ALG_CCM=y
CONFIG_PSA_WANT_ALG_CMAC=y
CONFIG_PSA_WANT_ALG_DETERMINISTIC_ECDSA=y
CONFIG_PSA_WANT_ALG_ECB_NO_PADDING=y
CONFIG_PSA_WANT_ALG_ECDH=y
CONFIG_PSA_WANT_ALG_ECDSA=y
CONFIG_PSA_WANT_ALG_GCM=y
CONFIG_PSA_WANT_ALG_HKDF=y
CONFIG_PSA_WANT_ALG_HMAC=y
CONFIG_PSA_WANT_ALG_PBKDF2_AES_CMAC_PRF_128=y
CONFIG_PSA_WANT_ALG_SHA_256=y
CONFIG_PSA_WANT_ECC_SECP_R1_256=y
CONFIG_PSA_WANT_GENERATE_RANDOM=y
CONFIG_PSA_WANT_KEY_TYPE_AES=y
CONFIG_PSA_WANT_KEY_TYPE_DERIVE=y
CONFIG_PSA_WANT_KEY_TYPE_HMAC=y
CONFIG_PSA_WANT_KEY_TYPE_PASSWORD=y
CONFIG_PSA_WANT_KEY_TYPE_RAW_DATA=y
CONFIG_PSA_WANT_KEY_TYPE_ECC_PUBLIC_KEY=y
CONFIG_PSA_WANT_KEY_TYPE_ECC_KEY_PAIR_IMPORT=y
CONFIG_PSA_WANT_KEY_TYPE_ECC_KEY_PAIR_EXPORT=y
CONFIG_PSA_WANT_KEY_TYPE_ECC_KEY_PAIR_GENERATE=y

# Persistent keys go through settings.
CONFIG_FLASH=y
CONFIG_FLASH_MAP=y
CONFIG_NVS=y
CONFIG_SETTINGS=y
CONFIG_SETTINGS_NVS=y

# The tests decode hex into heap buffers.
CONFIG_COMMON_LIBC_MALLOC_ARENA_SIZE=32768
CONFIG_MAIN_STACK_SIZE=8192

# Output over RTT, so the probe that flashes also reads the result.
CONFIG_USE_SEGGER_RTT=y
CONFIG_RTT_CONSOLE=y
CONFIG_UART_CONSOLE=n
CONFIG_SERIAL=n
```

## src/main.c
```c
/* SPDX-FileCopyrightText: 2026 Aseem Chopra */
/* SPDX-License-Identifier: Apache-2.0 */
/*
 * Board entry: the host suite, then a persistent key that must survive a
 * reset. The first boot stores it; the next boot finds it, checks it and
 * destroys it, so boots alternate between the two.
 */
#include <stdbool.h>
#include <stdio.h>
#include <string.h>

#include <psa/crypto.h>

int test_host_main(int argc, char **argv);

#define REBOOT_KEY_ID 0x2F001

static const uint8_t reboot_key[16] = { 0x00, 0x11, 0x22, 0x33, 0x44, 0x55, 0x66, 0x77,
					0x88, 0x99, 0xaa, 0xbb, 0xcc, 0xdd, 0xee, 0xff };

int main(void)
{
	psa_key_attributes_t a = PSA_KEY_ATTRIBUTES_INIT;
	psa_key_id_t id = 0;
	uint8_t out[sizeof(reboot_key)];
	size_t n = 0;
	psa_status_t st;
	int failed = test_host_main(0, NULL);

	st = psa_export_key(REBOOT_KEY_ID, out, sizeof(out), &n);
	if (st == PSA_ERROR_INVALID_HANDLE) {
		psa_set_key_id(&a, REBOOT_KEY_ID);
		psa_set_key_type(&a, PSA_KEY_TYPE_AES);
		psa_set_key_usage_flags(&a, PSA_KEY_USAGE_EXPORT);
		st = psa_import_key(&a, reboot_key, sizeof(reboot_key), &id);
		printf("reboot: key %s; reset to check it\n", st == PSA_SUCCESS ? "stored" : "NOT STORED");
		failed |= st != PSA_SUCCESS;
	} else {
		bool ok = st == PSA_SUCCESS && n == sizeof(reboot_key) &&
			  !memcmp(out, reboot_key, n);

		st = psa_destroy_key(REBOOT_KEY_ID);
		printf("reboot: key %s after reset, destroy %d\n", ok ? "intact" : "WRONG", (int)st);
		failed |= !ok || st != PSA_SUCCESS;
	}
	printf("target: %s\n", failed ? "FAIL" : "PASS");
	return failed;
}
```
